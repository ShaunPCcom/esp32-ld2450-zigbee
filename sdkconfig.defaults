## sdkconfig.defaults
```kconfig
#
# Partition Table (shared - target-specific files set the filename)
#
CONFIG_PARTITION_TABLE_CUSTOM=y
CONFIG_PARTITION_TABLE_OFFSET=0x8000

#
# Flash Size (H2 default; sdkconfig.defaults.esp32c6 overrides for 16MB)
#
CONFIG_ESPTOOLPY_FLASHSIZE_4MB=y
CONFIG_ESPTOOLPY_FLASHSIZE="4MB"

#
# Zigbee (shared - both H2 and C6 use native radio)
#
CONFIG_ZB_ENABLED=y
CONFIG_ZB_ZCZR=y
CONFIG_ZB_RADIO_NATIVE=y
```

## sdkconfig.defaults.esp32c6
```kconfig
#
# ESP32-C6 specific defaults
#

#
# Partition Table
#
CONFIG_PARTITION_TABLE_CUSTOM_FILENAME="partitions_c6.csv"

#
# Flash Size (16MB on nanoESP32-C6)
#
CONFIG_ESPTOOLPY_FLASHSIZE_16MB=y
CONFIG_ESPTOOLPY_FLASHSIZE="16MB"

#
# WiFi (C6 only - needed for web configuration UI)
#
CONFIG_ESP_WIFI_ENABLED=y

#
# HTTP server WebSocket support (for /ws/targets target stream)
#
CONFIG_HTTPD_WS_SUPPORT=y

#
# WiFi + Zigbee coexistence
#
CONFIG_ESP_COEX_ENABLED=y
CONFIG_ESP_COEX_SW_COEXIST_ENABLE=y

#
# Zigbee role: End Device (router mode is unstable with WiFi coexistence on C6)
#
CONFIG_LD2450_ZB_ROUTER=n

#
# Flash chip support (nanoESP32-C6 uses Boya flash)
#
CONFIG_SPI_FLASH_SUPPORT_BOYA_CHIP=y
```

## sdkconfig.defaults.esp32h2
```kconfig
#
# ESP32-H2 specific defaults
#

#
# Partition Table
#
CONFIG_PARTITION_TABLE_CUSTOM_FILENAME="partitions.csv"

#
# Flash Size (4MB on ESP32-H2-DevKitM-1)
#
CONFIG_ESPTOOLPY_FLASHSIZE_4MB=y
CONFIG_ESPTOOLPY_FLASHSIZE="4MB"

#
# Zigbee role: Router (H2 is dedicated 802.15.4, no coexistence issues)
#
CONFIG_LD2450_ZB_ROUTER=y
```
